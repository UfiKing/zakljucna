## sdkconfig.defaults
```kconfig
CONFIG_ESP_COREDUMP_ENABLE=y
CONFIG_ESP_COREDUMP_ENABLE_TO_FLASH=y
CONFIG_ESP_COREDUMP_DATA_FORMAT_BLOB=y
CONFIG_ESP_COREDUMP_MAX_TASKS_NUM=10
CONFIG_ESP_COREDUMP_TASK_BUF_MAX_LEN=128
CONFIG_ESP_COREDUMP_ENABLE_TO_UART=y
CONFIG_ESP_COREDUMP_UART_BAUD=115200
```
